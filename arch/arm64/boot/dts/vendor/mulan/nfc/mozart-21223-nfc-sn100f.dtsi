/**********************************************************************************
* Copyright (c)  2008-2020  Guangdong oplus Mobile Comm Corp., Ltd
* VENDOR_EDIT
* Description: oplus ST nfc dtsi
*
* Version: 1.0
* Date: 2020-10-15
* Author: wenjie.Liu
*
* ------------------------------ Revision History: --------------------------------
* <version>           <date>                <author>                            <desc>
* Revision 1.0       2020-10-15            wenjie.Liu           Created for odin ST nfc dts
***********************************************************************************/
&soc {
	//add for nfc_chipset
	nfc_chipset {
		compatible = "oplus-nfc-chipset";
		chipset-21223 = "SN100T";
	};
};

&qupv3_se10_i2c {
        status = "ok";
        #address-cells = <1>;
        #size-cells = <0>;
        nq@28 {
                compatible = "qcom,nq-nci";
                reg = <0x28>;
                qcom,nq-irq = <&tlmm 9 0x00>;
                qcom,nq-ven = <&tlmm 6 0x00>;
                qcom,nq-firm = <&tlmm 8 0x00>;
                qcom,nq-clkreq = <&tlmm 7 0x00>;
                interrupt-parent = <&tlmm>;
                interrupts = <9 0>;
                interrupt-names = "nfc_irq";
                pinctrl-names = "nfc_active", "nfc_suspend";
                pinctrl-0 = <&nfc_int_active &nfc_enable_active>;
                pinctrl-1 = <&nfc_int_suspend &nfc_enable_suspend>;
        };
};