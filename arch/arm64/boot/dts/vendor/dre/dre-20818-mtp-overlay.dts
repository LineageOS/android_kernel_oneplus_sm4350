/dts-v1/;
/plugin/;

#include <dt-bindings/interrupt-controller/arm-gic.h>
#include "dre-mtp-overlay.dtsi"
#include "nfc/dre-20818-nfc-mtp.dtsi"


/* DTBO: project Special overlay */

/ {
	model = "Qualcomm Technologies, Inc. Holi MTP";
	compatible = "qcom,holi-mtp", "qcom,holi", "qcom,mtp";
	qcom,msm-id = <454 0x10000>, <472 0x10000>;
	qcom,board-id = <8 0>;
	oplus,dtsi_no = <133144 133180>;
};

#include "camera/dre-20818-camera-sensor-mtp.dtsi"

#include "sensor/dre-20818-sensor-mtp.dtsi"
